## drivers/vendor/common/Kconfig
```kconfig
config VENDOR_COMMON_COMPILE
	bool "drivers/vendor/common drivers compile control"
	default n
	help
	  This enables drivers/vendor/common drivers to be compiled.

config VENDOR_SOC_QCOM_COMPILE
	bool "drivers/vendor/soc/qcom drivers compile control"
	default n
	help
	  This enables drivers/vendor/soc/qcom drivers to be compiled.

config VENDOR_SOC_MTK_COMPILE
	bool "drivers/vendor/soc/mediatek drivers compile control"
	default n
	help
	  This enables drivers/vendor/soc/mediatek drivers to be compiled.

config VENDOR_SOC_SPRD_COMPILE
	bool "drivers/vendor/soc/sprd drivers compile control"
	default n
	help
	  This enables drivers/vendor/soc/sprd drivers to be compiled.

config SOC_QCOM
	bool "qcom common drivers"
	default n
	help
	  This enables support for common driver in qcom platform.

config SOC_MTK
	bool "MTK common drivers"
	default n
	help
	  This enables support for common driver in MTK platform.

config SOC_SPRD
	bool "spred common drivers"
	default n
	help
	  This enables support for common driver in sprd platform.

source "drivers/vendor/common/touchscreen/Kconfig"
source "drivers/vendor/common/nxp_tfa9894/Kconfig"
source "drivers/vendor/common/power/Kconfig"
source "drivers/vendor/common/sqc/Kconfig"
source "drivers/vendor/common/vcfg/Kconfig"
source "drivers/vendor/common/awinic/Kconfig"
source "drivers/vendor/common/tfa9873/Kconfig"
```

## drivers/vendor/common/awinic/Kconfig
```kconfig
config SND_SMARTPA_AW881XX
	tristate "SoC Audio for awinic aw881xxseries"
	depends on I2C
	help
   	  This option enables support for aw881xxseries Smart PA.
```

## drivers/vendor/common/sqc/Kconfig
```kconfig
menuconfig VENDOR_SQC_CHARGER
	bool "zte power policy"
	default n
	help
	  Say Y here, if supported zte sqc charger
```

## drivers/vendor/common/touchscreen/Kconfig
```kconfig
#
# Touchscreen driver configuration
#
menuconfig TOUCHSCREEN_VENDOR
	bool "Touchscreens"
	default n
	help
	  Say Y here, and a list of supported touchscreens will be displayed.
	  This option doesn't affect the kernel.

	  If unsure, say n.

if TOUCHSCREEN_VENDOR

source "drivers/vendor/common/touchscreen/focaltech_touch_v3/Kconfig"
source "drivers/vendor/common/touchscreen/hxchipset/Kconfig"
source "drivers/vendor/common/touchscreen/hxchipset_v2/Kconfig"
source "drivers/vendor/common/touchscreen/synaptics_2.7/Kconfig"
source "drivers/vendor/common/touchscreen/gt1x_driver/Kconfig"
source "drivers/vendor/common/touchscreen/tlsc6x_v2/Kconfig"
source "drivers/vendor/common/touchscreen/focaltech_touch_V2_2/Kconfig"
source "drivers/vendor/common/touchscreen/chipone_tddi/Kconfig"
source "drivers/vendor/common/touchscreen/hynitron/Kconfig"
source "drivers/vendor/common/touchscreen/synaptics_tcm/Kconfig"
source "drivers/vendor/common/touchscreen/ilitek/Kconfig"
source "drivers/vendor/common/touchscreen/ilitek_tddi_9881x/Kconfig"
source "drivers/vendor/common/touchscreen/chipone_ts/Kconfig"
source "drivers/vendor/common/touchscreen/gtx8_zte/Kconfig"
source "drivers/vendor/common/touchscreen/tlsc6x_v3/Kconfig"
source "drivers/vendor/common/touchscreen/NVT_Touch_HostDL/Kconfig"

config TS_FIRMWARE
	string "config board firmware folder"

config TP_BSC_CALIBRATION
        bool "tp bsc calibration, synaptics_tcm driver need this node"
		default n
		help
		This enables tp bsc calibration.

config TP_DETECT_BY_LCDINFO
        bool "tp ic detected by lcd information"
		default n
		help
		This enables support for tp ic detected by lcd information.

config DRM_PANEL_NOTIFIER
	bool "add qcom drm panel support"
	default n
	help
	  Say Y here to enable debug tools.

	  If unsure, say N.

config TPD_UFP_MAC
	bool "tp under fingerprint status machine"
	default n
	help
	  Say Y here if you want to have a under fingerprint status machine
	  If unsure, say N.
config SCREEN_ON_TEMP_SUPPORT
	bool "lcd has a temp on when off to aod"
	depends on TPD_UFP_MAC
	default n
	help
		Say y here if your lcd has a temp on when off to aod
		if unsure, say n.

endif
```

## drivers/vendor/common/touchscreen/chipone_ts/Kconfig
```kconfig
#
# Chipone Touchscreen driver configuration
#

config TOUCHSCREEN_CHIPONE_TS
	bool "Chipone TS Touchscreen"
		depends on I2C
		default n
		help
		  Say Y here if you have Chipone touch panel.
		  If unsure, say N.
```

## drivers/vendor/common/touchscreen/focaltech_touch_V2_2/Kconfig
```kconfig
#
# Focaltech Touchscreen driver configuration
#
config TOUCHSCREEN_FTS_V2_2
	bool "Focaltech Touchscreen"
		depends on I2C
		default n
		help
		  Say Y here if you have Focaltech touch panel.
		  If unsure, say N.

config TS_FTS_MTK_INTERFACE
	tristate "Focaltech driver test over Dragon Board"
	depends on TOUCHSCREEN_FTS_V2_2
	help
	  This enables support for Focaltech driver in MTK platform.
```

## drivers/vendor/common/touchscreen/gt1x_driver/Kconfig
```kconfig
#
# goodix gt1x Touchscreen driver configuration
#

config TOUCHSCREEN_GT1X_DRIVER
	bool "goodix gt1x touchscreen"
	depends on I2C
	default n
	help
	  Say Y here if you have a goodix gt1x touchscreen connected.

	  If unsure, say N.
```

## drivers/vendor/common/touchscreen/hynitron/Kconfig
```kconfig
#
# Touchscreen driver configuration
#
config TOUCHSCREEN_HYNITRON
	bool "Hynitron Ts for SPRD"
	depends on I2C
	default n
	help
	  Say Y here if you have Hynitron touch panel.
	  If unsure, say N.
```

## drivers/vendor/common/touchscreen/ilitek/Kconfig
```kconfig
#
# Iltek Touchscreen driver configuration
#

config TOUCHSCREEN_ILITEK
	bool "Ilitek Touchscreen"
	default n
	help
	Say Y here if you have ilitek touch panel.

if TOUCHSCREEN_ILITEK
config TOUCHSCREEN_ILITEK_I2C
	bool "Ilitek Touchscreen"
	depends on I2C
	default n
	help
	Say Y here if you have ilitek i2c touch panel.

config TOUCHSCREEN_ILITEK_SPI
	bool "Ilitek Touchscreen"
	depends on SPI
	default n
	help
	Say Y here if you have ilitek spi touch panel.
endif
```

## drivers/vendor/common/touchscreen/tlsc6x_v2/Kconfig
```kconfig
#
# TLSC6X_V2 Touchscreen driver configuration
#

config TOUCHSCREEN_TLSC6X_V2
	bool "Focaltech Touchscreen"
		depends on I2C
		default n
		help
		  Say Y here if you have tlsc6x touch panel.
		  If unsure, say N.

if TOUCHSCREEN_TLSC6X_V2
config CHSC_CHIPS
	string "config tlsc chip folder"
endif
```

## drivers/vendor/soc/qcom/Kconfig
```kconfig
config VENDOR_SOC_QCOM_SRC
	bool "drivers/vendor/soc/qcom drivers compile control"
	default n
	help
		This enables drivers/vendor/soc/qcom drivers to be compiled.

source "drivers/vendor/soc/qcom/vlog/Kconfig"
source "drivers/vendor/soc/qcom/logcat/Kconfig"
source "drivers/vendor/soc/qcom/sdlog/Kconfig"
source "drivers/vendor/soc/qcom/pmlog/Kconfig"
source "drivers/vendor/soc/qcom/klog/Kconfig"
source "drivers/vendor/soc/qcom/imem_info/Kconfig"
source "drivers/vendor/soc/qcom/vcfg/Kconfig"
source "drivers/vendor/soc/qcom/dpn/Kconfig"
source "drivers/vendor/soc/qcom/subsys_restart/Kconfig"
source "drivers/vendor/soc/qcom/debugpolicy/Kconfig"
source "drivers/vendor/soc/qcom/nubia_hw_version/Kconfig"
```

## drivers/vendor/soc/qcom/debugpolicy/Kconfig
```kconfig
config VENDOR_DEBUG_POLICY
  bool "DEBUG POLICY Driver"
  default n
  help
    This program is used for enable debug policy driver
```

## drivers/vendor/soc/qcom/klog/Kconfig
```kconfig
#
# printk_ext driver
#
config PRINTK_EXT
    bool "/proc/kmsg_ext support"
    default n
    help
      Say Y here if you want to support the /proc/kmsg_ext. In
      this case, carve out a block of memory to store a specific
      log, rather than store it in the printk's buffer.

config TIME_FORMAT_ZTELOG
    bool "ZTE kernel log format"
    default n
    help
      Say Y here if you want to include process_id,pid,comm and time information
      in __log_buf record.

config PARSE_LOGBUF_FROM_DUMP
    bool "split __log_buf info from dump"
    default n
    help
      Say Y here if you want to split __log_buf information from dump.
```

## drivers/vendor/soc/qcom/logcat/Kconfig
```kconfig
#
# vlog driver
#

config DUAL_SYSTEM_LOGCAT
	bool "DUAL SYSTEM LOGCAT"
	---help---
	  Note that enabling this will open DUAL SYSTEM KERNEL LOG DRIVER.

config ANDROID_LOGGER
	tristate "Android log driver"
	default n
	---help---
	  Just Config a feature to adapt P \ Q and other later platform.

config ANDROID_ZLOG
	tristate "Android log driver"
	default n
	---help---
	  This adds support for system-wide logging using four log buffers.

	  These are:

	      1: main
	      2: events
	      3: radio
	      4: system

	  Log reading and writing is performed via normal Linux reads and
	  optimized writes. This optimization avoids logging having too
	  much overhead in the system.

config ANDROID_ZLOG_BUFFER
	bool "Zte uses the android kernel logger buffer"
	depends on ANDROID_ZLOG
	default n
	---help---
	  This adds support for unnecessary creating zlog buffers.

	  Logger will check whether android zlog buffer should be created:

	      N: kern_transport param is 0
	      N: user build version with no kern_transport param
	      Y: kern_transport param is 1
	      Y: userdebug or eng with no kern_transport param

config ANDROID_ZLOG_LOW_MEM
	bool "Zte uses less buffer size when low mem config detected"
	depends on ANDROID_ZLOG
	default n
	---help---
	  This adds support for low memory configuration for zlog buffers.
	  Logger will check whether low mem config is used:
	      Y: totalram_pages <= 512M
	  If yes, a ratio factor will be used to decrease the buffer size.
```

## drivers/vendor/soc/qcom/nubia_hw_version/Kconfig
```kconfig
config NUBIA_HW_VERSION
	bool "NUBIA HW VERSION INFO"
	default n
	help
	  Say 'y' here to include support for nubia hw version info.
```

## drivers/vendor/soc/qcom/pmlog/Kconfig
```kconfig
#
# pmlog driver
#
config VENDOR_PMLOG
  bool "PMLOG Driver"
  default n
  help
    This program is used for recode the ap and modem's sleep and wake time
```

## drivers/vendor/soc/qcom/sdlog/Kconfig
```kconfig
#
# Sdlog Driver
#

config VENDOR_SDLOG
	bool "Sdlog Driver"
	default n
	help
	  This program is used for capture the modem log.
```

## drivers/vendor/soc/qcom/subsys_restart/Kconfig
```kconfig
config VENDOR_SUBSYS_RESTART
	bool "VENDOR_SUBSYS_RESTART"
	default n
	help
	  Say 'y' here to include support for vendor subsystem restart.
```

## drivers/vendor/soc/qcom/vlog/Kconfig
```kconfig
#
# vlog driver
#
config VENDOR_VLOG
  bool "Modem Vlog Driver"
  default n
  help
  This driver allow modem to output log into the data file of ap
  It read the log from reserved memory from ap, and notify app
  process to write the log to logfile

config VENDOR_VLOG_V2
  bool "VENDOR_VLOG_V2"
  default n
  help
  This driver allow modem to output log into the data file of ap
  It read the log from reserved memory from ap, and notify app
  process to write the log to logfile
```
