&mdss_mdp {
	dsi_leia_ft8203_dual_video: qcom,mdss_dsi_leia_ft8203_dual_video {
		qcom,mdss-dsi-panel-name = "Dual leia ft8203 video mode dsi panel";
		qcom,mdss-dsi-panel-type = "dsi_video_mode";
		qcom,dsi-ctrl-num = <0 1>;
		qcom,dsi-phy-num = <0 1>;
		qcom,mdss-dsi-virtual-channel-id = <0>;
		qcom,mdss-dsi-stream = <0>;
		qcom,mdss-dsi-panel-hdr-enabled;
		qcom,mdss-dsi-panel-hdr-color-primaries = <14500 15500 32000 17000 15500 30000 8000 3000>;
		qcom,mdss-dsi-panel-peak-brightness = <4200000>;
		qcom,mdss-dsi-panel-blackness-level = <3230>;
		qcom,mdss-dsi-traffic-mode = "non_burst_sync_event";
		qcom,mdss-dsi-bllp-eof-power-mode;
		qcom,mdss-dsi-bllp-power-mode;
		qcom,mdss-dsi-lane-0-state;
		qcom,mdss-dsi-lane-1-state;
		qcom,mdss-dsi-lane-2-state;
		qcom,mdss-dsi-lane-3-state;
		qcom,mdss-dsi-dma-trigger = "trigger_sw";
		qcom,mdss-dsi-mdp-trigger = "none";
		qcom,mdss-dsi-reset-sequence = <1 20 0 20 1 50>;
		qcom,mdss-pan-physical-width-dimension = <74>;
		qcom,mdss-pan-physical-height-dimension = <131>;
		qcom,mdss-dsi-tx-eot-append;
		qcom,mdss-dsi-underflow-color = <1023>;
		qcom,mdss-dsi-border-color = <0>;
		qcom,mdss-dsi-bpp = <24>;
		qcom,panel-supply-entries = <&dsi_panel_pwr_supply_avdd>;
		qcom,mdss-dsi-bl-pmic-control-type = "bl_ctrl_pwm";
		pwms = <&pm8350c_pwm_2 0 0>;
		qcom,bl-pmic-pwm-period-usecs = <100>;
		qcom,mdss-dsi-bl-min-level = <1>;
		qcom,mdss-dsi-bl-max-level = <1023>;
		qcom,mdss-brightness-max-level = <255>;
		zte,disp_vsp_en_gpio = <&tlmm 8 0>;
		zte,disp_vsn_en_gpio = <&tlmm 9 0>;
		zte,disp_iovdd_en_gpio = <&tlmm 26 0>;
		zte,disp_2dbl_en_gpio = <&tlmm 50 0>;
		zte,disp_3dbl_en_gpio = <&tlmm 76 0>;
		zte,disp_3d3_adc_pin = <&tlmm 84 0>;
		qcom,platform-reset-gpio = <&tlmm 24 0>;
		qcom,dsi-select-clocks = "mux_byte_clk0", "mux_pixel_clk0";
		qcom,mdss-dsi-panel-status-check-mode = "reg_read";
		qcom,mdss-dsi-panel-status-command = [06 01 00 01 00 00 01 0a];
		qcom,mdss-dsi-panel-status-command-state = "dsi_hs_mode";
		qcom,mdss-dsi-panel-status-value = <156>;
		qcom,mdss-dsi-panel-on-check-value = <156>;
		qcom,mdss-dsi-panel-status-read-length = <1>;
		qcom,esd-check-enabled;
		qcom,mdss-dsi-display-timings {
			timing@0 {
				qcom,mdss-dsi-panel-width = <1280>;
				qcom,mdss-dsi-panel-height = <1600>;
				qcom,mdss-dsi-h-front-porch = <10>;
				qcom,mdss-dsi-h-back-porch = <5>;
				qcom,mdss-dsi-h-pulse-width = <5>;
				qcom,mdss-dsi-h-sync-skew = <0>;
				qcom,mdss-dsi-v-back-porch = <10>;
				qcom,mdss-dsi-v-front-porch = <255>;
				qcom,mdss-dsi-v-pulse-width = <6>;
				qcom,mdss-dsi-h-sync-pulse = <0>;
				qcom,mdss-dsi-panel-framerate = <60>;
				qcom,mdss-dsi-on-command = [29 01 00 00 00 00 02 00 00
					29 01 00 00 00 00 04 ff 82 01 01
					29 01 00 00 00 00 02 00 80
					29 01 00 00 00 00 03 ff 82 01
					29 01 00 00 00 00 02 00 93
					29 01 00 00 00 00 02 c5 2a
					29 01 00 00 00 00 02 00 97
					29 01 00 00 00 00 02 c5 2a
					29 01 00 00 00 00 02 00 9e
					29 01 00 00 00 00 02 c5 00
					29 01 00 00 00 00 02 00 9a
					29 01 00 00 00 00 02 c5 25
					29 01 00 00 00 00 02 00 9c
					29 01 00 00 00 00 02 c5 25
					29 01 00 00 00 00 02 00 b6
					29 01 00 00 00 00 03 c5 1b 1b
					29 01 00 00 00 00 02 00 b8
					29 01 00 00 00 00 03 c5 1b 1b
					29 01 00 00 00 00 02 00 00
					29 01 00 00 00 00 03 d8 aa aa
					29 01 00 00 00 00 02 00 82
					29 01 00 00 00 00 02 c5 95
					29 01 00 00 00 00 02 00 83
					29 01 00 00 00 00 02 c5 07
					29 01 00 00 00 00 02 00 00
					29 01 00 00 00 00 11 e1 05 0d 22 34 3f 4b 5f 6c 6f 7d 80 93 6f 5c 5d 52
					29 01 00 00 00 00 02 00 10
					29 01 00 00 00 00 09 e1 4b 41 32
					29 21 14 05 02 29 01 00 00 00 00 02 00 00
					29 01 00 00 00 00 11 e2 05 0d 22 34 3f 4b 5f 6c 6f 7d 80 93 6f 5c 5d 52
					29 01 00 00 00 00 02 00 10
					29 01 00 00 00 00 09 e2 4b 41 32 29 21 14 05 02
					29 01 00 00 00 00 02 00 80
					29 01 00 00 00 00 02 a4 8c
					29 01 00 00 00 00 02 00 a0
					29 01 00 00 00 00 02 f3 10
					29 01 00 00 00 00 02 00 a1
					29 01 00 00 00 00 03 b3 0a 00
					29 01 00 00 00 00 02 00 a3
					29 01 00 00 00 00 03 b3 06 40
					29 01 00 00 00 00 02 00 a5
					29 01 00 00 00 00 03 b3 60 13
					29 01 00 00 00 00 02 00 d0
					29 01 00 00 00 00 02 c1 30
					29 01 00 00 00 00 02 00 a0
					29 01 00 00 00 00 02 b3 92
					29 01 00 00 00 00 02 00 a4
					29 01 00 00 00 00 02 c4 f0
					29 01 00 00 00 00 02 00 86
					29 01 00 00 00 00 07 c0 02 03 01 02 1f 09
					29 01 00 00 00 00 02 00 b3
					29 01 00 00 00 00 07 ce 02 03 01 02 1f 09
					29 01 00 00 00 00 02 00 f0
					29 01 00 00 00 00 02 cd 1e
					29 01 00 00 00 00 02 00 a5
					29 01 00 00 00 00 02 c4 50
					29 01 00 00 00 00 02 00 f3
					29 01 00 00 00 00 03 cd 18 40
					29 01 00 00 00 00 02 00 80
					29 01 00 00 00 00 08 cb 3f 33 30 3f 30 33 30
					29 01 00 00 00 00 02 00 87
					29 01 00 00 00 00 02 cb 3f
					29 01 00 00 00 00 02 00 88
					29 01 00 00 00 00 09 cb 00 3f 33 33 33 30 3f 3f
					29 01 00 00 00 00 02 00 90
					29 01 00 00 00 00 08 cb 00 33 33 33 30 30 3f
					29 01 00 00 00 00 02 00 97
					29 01 00 00 00 00 02 cb 3f
					29 01 00 00 00 00 02 00 98
					29 01 00 00 00 00 09 cb d7 14 14 d4 14 14 14 d7
					29 01 00 00 00 00 02 00 a0
					29 01 00 00 00 00 09 cb 00 fc 14 14 14 14 eb d4
					29 01 00 00 00 00 02 00 a8
					29 01 00 00 00 00 09 cb 28 14 14 14 14 14 d7 c0
					29 01 00 00 00 00 02 00 b0
					29 01 00 00 00 00 08 cb ff 00 00 00 00 00 00
					29 01 00 00 00 00 02 00 b7
					29 01 00 00 00 00 02 cb ff
					29 01 00 00 00 00 02 00 b8
					29 01 00 00 00 00 09 cb 00 00 00 00 00 00 ff 00
					29 01 00 00 00 00 02 00 c0
					29 01 00 00 00 00 08 cb 00 00 00 00 00 00 00
					29 01 00 00 00 00 02 00 c7
					29 01 00 00 00 00 02 cb 00
					29 01 00 00 00 00 02 00 d0
					29 01 00 00 00 00 0b cb 03 03 03 03 03 03 03 03 03 03
					29 01 00 00 00 00 02 00 80
					29 01 00 00 00 00 09 cc 2d 2d 2d 13 13 13 07 08
					29 01 00 00 00 00 02 00 88
					29 01 00 00 00 00 09 cc 2c 17 2b 2b 01 26 26 11
					29 01 00 00 00 00 02 00 90
					29 01 00 00 00 00 07 cc 12 0f 10 2c 23 24
					29 01 00 00 00 00 02 00 80
					29 01 00 00 00 00 09 cd 2d 2d 2d 13 13 13 07 08
					29 01 00 00 00 00 02 00 88
					29 01 00 00 00 00 09 cd 2c 17 2b 2b 01 26 26 11
					29 01 00 00 00 00 02 00 90
					29 01 00 00 00 00 07 cd 12 0f 10 2c 23 24
					29 01 00 00 00 00 02 00 a0
					29 01 00 00 00 00 09 cc 2d 2d 2d 13 13 13 08 07
					29 01 00 00 00 00 02 00 a8
					29 01 00 00 00 00 09 cc 17 2c 2b 2b 01 26 26 10
					29 01 00 00 00 00 02 00 b0
					29 01 00 00 00 00 07 cc 0f 12 11 2c 23 24
					29 01 00 00 00 00 02 00 a0
					29 01 00 00 00 00 09 cd 2d 2d 2d 13 13 13 08 07
					29 01 00 00 00 00 02 00 a8
					29 01 00 00 00 00 09 cd 17 2c 2b 2b 01 26 26 10
					29 01 00 00 00 00 02 00 b0
					29 01 00 00 00 00 07 cd 0f 12 11 2c 23 24
					29 01 00 00 00 00 02 00 81
					29 01 00 00 00 00 02 c2 40
					29 01 00 00 00 00 02 00 90
					29 01 00 00 00 00 05 c2 84 02 5c 8c
					29 01 00 00 00 00 02 00 94
					29 01 00 00 00 00 05 c2 83 02 5c 8c
					29 01 00 00 00 00 02 00 e0
					29 01 00 00 00 00 09 c2 8b 09 01 5f 8a 00 00 03
					29 01 00 00 00 00 02 00 e8
					29 01 00 00 00 00 09 c2 8a 0a 01 5f 8a 00 00 03
					29 01 00 00 00 00 02 00 f0
					29 01 00 00 00 00 09 c2 89 07 01 5f 8a 00 00 03
					29 01 00 00 00 00 02 00 f8
					29 01 00 00 00 00 09 c2 88 08 01 5f 8a 00 00 03
					29 01 00 00 00 00 02 00 e0
					29 01 00 00 00 00 05 c3 36 49 00 b7
					29 01 00 00 00 00 02 00 e4
					29 01 00 00 00 00 05 c3 35 49 00 76
					29 01 00 00 00 00 02 00 e8
					29 01 00 00 00 00 05 c3 35 49 00 76
					29 01 00 00 00 00 02 00 a0
					29 01 00 00 00 00 05 c3 01 66 4a 4f
					29 01 00 00 00 00 02 00 fd
					29 01 00 00 00 00 02 cb 82
					29 01 00 00 00 00 02 00 80
					29 01 00 00 00 00 07 c0 00 b2 00 ff 00 10
					29 01 00 00 00 00 02 00 90
					29 01 00 00 00 00 07 c0 00 b2 00 ff 00 10
					29 01 00 00 00 00 02 00 a0
					29 01 00 00 00 00 07 c0 01 64 00 ff 00 10
					29 01 00 00 00 00 02 00 b0
					29 01 00 00 00 00 06 c0 00 b2 00 ff 10
					29 01 00 00 00 00 02 00 a3
					29 01 00 00 00 00 04 c1 19 19 04
					29 01 00 00 00 00 02 00 80
					29 01 00 00 00 00 02 ce 00
					29 01 00 00 00 00 02 00 d0
					29 01 00 00 00 00 09 ce 01 00 0d 01 01 00 ca 00
					29 01 00 00 00 00 02 00 e0
					29 01 00 00 00 00 02 ce 00
					29 01 00 00 00 00 02 00 f0
					29 01 00 00 00 00 02 ce 00
					29 01 00 00 00 00 02 00 b0
					29 01 00 00 00 00 05 cf 00 00 6c 70
					29 01 00 00 00 00 02 00 b5
					29 01 00 00 00 00 05 cf 03 03 27 2b
					29 01 00 00 00 00 02 00 c0
					29 01 00 00 00 00 05 cf 05 05 d7 d8
					29 01 00 00 00 00 02 00 c5
					29 01 00 00 00 00 05 cf 00 06 08 40
					29 01 00 00 00 00 02 00 90
					29 01 00 00 00 00 02 c4 88
					29 01 00 00 00 00 02 00 92
					29 01 00 00 00 00 02 c4 c0
					29 01 00 00 00 00 02 00 c5
					29 01 00 00 00 00 05 c3 00 00 00 00
					29 01 00 00 00 00 02 00 c9
					29 01 00 00 00 00 02 ce 00
					29 01 00 00 00 00 02 1c 00
					29 01 00 00 00 00 02 00 d6
					29 01 00 00 00 00 02 c1 00
					29 01 00 00 00 00 02 00 d5
					29 01 00 00 00 00 02 c0 f0
					29 01 00 00 00 00 02 00 a0
					29 01 00 00 00 00 02 c1 e0
					29 01 00 00 00 00 02 00 9f
					29 01 00 00 00 00 02 c5 00
					29 01 00 00 00 00 02 00 91
					29 01 00 00 00 00 02 c5 4c
					29 01 00 00 00 00 02 00 d7
					29 01 00 00 00 00 02 ce 01
					29 01 00 00 00 00 02 00 94
					29 01 00 00 00 00 02 c5 44
					29 01 00 00 00 00 02 00 98
					29 01 00 00 00 00 02 c5 44
					29 01 00 00 00 00 02 00 9b
					29 01 00 00 00 00 02 c5 25
					29 01 00 00 00 00 02 00 9d
					29 01 00 00 00 00 02 c5 25
					29 01 00 00 00 00 02 00 9a
					29 01 00 00 00 00 02 cf ff
					29 01 00 00 00 00 02 00 82
					29 01 00 00 00 00 02 a5 01
					29 01 00 00 00 00 02 00 8c
					29 01 00 00 00 00 03 cf 11 28
					29 01 00 00 00 00 02 00 bb
					29 01 00 00 00 00 05 c5 08 0d 09 0b
					29 01 00 00 00 00 02 00 a2
					29 01 00 00 00 00 02 f5 1f
					29 01 00 00 00 00 02 00 c1
					29 01 00 00 00 00 02 c0 11
					29 01 00 00 00 00 02 00 9a
					29 01 00 00 00 00 02 f5 3f
					29 01 00 00 00 00 02 00 9c
					29 01 00 00 00 00 02 f5 1e
					29 01 00 00 00 00 02 00 b6
					29 01 00 00 00 00 02 c0 02
					29 01 00 00 00 00 02 00 84
					29 01 00 00 00 00 03 c5 4f 4f
					29 01 00 00 00 00 02 00 89
					29 01 00 00 00 00 02 c4 0b
					29 01 00 00 00 00 02 00 8d
					29 01 00 00 00 00 02 c4 5c
					29 01 00 00 00 00 02 00 a4
					29 01 00 00 00 00 02 f3 0b
					29 01 00 00 00 00 02 00 00
					29 01 00 00 00 00 02 fa 02
					29 01 00 00 00 00 02 00 a8
					29 01 00 00 00 00 02 c5 09
					29 01 00 00 00 00 02 00 cb
					29 01 00 00 00 00 02 c5 01
					29 01 00 00 00 00 02 00 b6
					29 01 00 00 00 00 03 c5 1b 1b
					29 01 00 00 00 00 02 00 b8
					29 01 00 00 00 00 03 c5 1b 1b
					29 01 00 00 00 00 02 00 91
					29 01 00 00 00 00 02 a5 00
					29 01 00 00 00 00 02 00 b2
					29 01 00 00 00 00 02 ce 60
					29 01 00 00 00 00 02 00 a4
					29 01 00 00 00 00 02 f3 0b
					29 01 00 00 00 00 02 00 00
					29 01 00 00 00 00 02 fa 5a
					29 01 00 00 00 00 02 00 a4
					29 01 00 00 00 00 02 f3 0b
					29 01 00 00 00 00 02 00 00
					29 01 00 00 00 00 02 fa 01
					29 01 00 00 00 00 02 00 a8
					29 01 00 00 00 00 02 c5 09
					29 01 00 00 00 00 02 00 cb
					29 01 00 00 00 00 02 c5 09
					29 01 00 00 00 00 02 00 b6
					29 01 00 00 00 00 03 c5 19 19
					29 01 00 00 00 00 02 00 b8
					29 01 00 00 00 00 03 c5 19 19
					29 01 00 00 00 00 02 00 91
					29 01 00 00 00 00 02 a5 40
					29 01 00 00 00 00 02 00 b2
					29 01 00 00 00 00 02 ce 60
					29 01 00 00 00 00 02 00 a4
					29 01 00 00 00 00 02 f3 0b
					29 01 00 00 00 00 02 00 00
					29 01 00 00 00 00 02 fa 5a
					29 01 00 00 00 00 02 00 00
					29 01 00 00 00 00 04 ff 00 00 00
					29 01 00 00 00 00 02 00 80
					29 01 00 00 00 00 03 ff 00 00
					05 01 00 00 78 00 01 11
					05 01 00 00 00 00 01 29
					29 01 00 00 00 00 02 35 00
				];
				qcom,mdss-dsi-off-command = [05 01 00 00 78 00 02 28 00
					05 01 00 00 78 00 02 10 00
				];
				qcom,mdss-dsi-on-command-state = "dsi_lp_mode";
				qcom,mdss-dsi-off-command-state = "dsi_lp_mode";
				qcom,mdss-dsi-panel-phy-timings = [00 1d 08 07 17 22 08 08 08 02 04 00 19 0c];
				qcom,display-topology = <2 0 2 1 0 2>;
				qcom,default-topology-index = <0>;
			};
		};
	};
};
