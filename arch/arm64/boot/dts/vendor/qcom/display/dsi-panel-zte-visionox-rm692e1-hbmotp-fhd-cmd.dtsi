&mdss_mdp {
    dsi_visionox_rm692e1_hbmotp_fhd_cmd: qcom,dsi_visionox_rm692e1_hbmotp_cmd_display {
		qcom,mdss-dsi-panel-name = "Visionox-RM692E1-HBMOTP-1080-2400-6P67Inch";
		qcom,mdss-dsi-panel-type = "dsi_cmd_mode";
		qcom,mdss-dsi-panel-physical-type = "oled";
		qcom,dsi-ctrl-num = <0>;
		qcom,dsi-phy-num = <0>;
		qcom,mdss-dsi-virtual-channel-id = <0>;
		qcom,mdss-dsi-stream = <0>;
		qcom,mdss-dsi-bpp = <24>;
		qcom,mdss-dsi-underflow-color = <0xff>;
		qcom,mdss-dsi-border-color = <0>;
		qcom,mdss-dsi-traffic-mode = "burst_mode";
		qcom,mdss-dsi-te-pin-select = <1>;
		qcom,mdss-dsi-te-dcs-command = <1>;
		qcom,mdss-dsi-te-check-enable;
		qcom,mdss-dsi-te-using-te-pin;
		qcom,mdss-dsi-bllp-eof-power-mode;
		qcom,mdss-dsi-bllp-power-mode;
		qcom,mdss-dsi-lane-0-state;
		qcom,mdss-dsi-lane-1-state;
		qcom,mdss-dsi-lane-2-state;
		qcom,mdss-dsi-lane-3-state;
		qcom,mdss-dsi-lp11-init;
		qcom,mdss-dsi-reset-sequence = <1 20 0 20 1 160>;
		qcom,mdss-dsi-tx-eot-append;
		qcom,mdss-dsi-post-init-delay = <1>;
		qcom,mdss-dsi-dma-trigger = "trigger_sw";
		qcom,mdss-dsi-mdp-trigger = "none";
		qcom,mdss-dsi-bl-min-level = <1900>;
		qcom,mdss-dsi-bl-max-level = <2047>;
		qcom,mdss-dsi-bl-pmic-control-type = "bl_ctrl_dcs";
		qcom,mdss-dsi-panel-hdr-enabled;
		qcom,mdss-dsi-panel-hdr-color-primaries = <14630 15656 33555 16453 11915 35880 6700 2145>;
		qcom,mdss-dsi-panel-peak-brightness = <6280000>;
		qcom,mdss-dsi-panel-blackness-level = <32>;
		zte,lcm_backlight_curve_mode = "lcd_brightness_max_rm692c9_lux";
		qcom,panel-supply-entries = <&dsi_panel_pwr_supply>;
		qcom,mdss-brightness-max-level = <255>;
		qcom,platform-reset-gpio = <&tlmm 24 0>;
		zte,disp_iovdd_en_gpio = <&pm8350_gpios 9 1>;
		qcom,mdss-dsi-bl-inverted-dbv;
		qcom,dsi-select-clocks = "mux_byte_clk0", "mux_pixel_clk0";
		qcom,dsi-panel-gpio-address = <0xf100000 0x1000>;
		qcom,dsi-panel-gpio-pins = <12 24 82>;
		qcom,dsi-panel-gpio-names = "reg-gpio", "reset-gpio", "platform-te-gpio";

		qcom,mdss-dsi-display-timings {
			timing@0 {
				qcom,mdss-dsi-panel-width = <1080>;
				qcom,mdss-dsi-panel-height = <2400>;
				qcom,mdss-dsi-h-front-porch = <26>;
				qcom,mdss-dsi-h-back-porch = <36>;
				qcom,mdss-dsi-h-pulse-width = <2>;
				qcom,mdss-dsi-h-sync-skew = <0>;
				qcom,mdss-dsi-v-back-porch = <12>;
				qcom,mdss-dsi-v-front-porch = <15>;
				qcom,mdss-dsi-v-pulse-width = <8>;
				qcom,mdss-dsi-h-sync-pulse = <0>;
				qcom,mdss-dsi-h-left-border = <0>;
				qcom,mdss-dsi-h-right-border = <0>;
				qcom,mdss-dsi-v-top-border = <0>;
				qcom,mdss-dsi-v-bottom-border = <0>;
				qcom,mdss-dsi-panel-framerate = <60>;
				qcom,mdss-dsi-on-command = [39 01 00 00 00 00 02 fe 00
					39 01 00 00 00 00 02 fa 07
					39 01 00 00 00 00 02 c2 08
					39 01 00 00 00 00 02 35 00
					39 01 00 00 00 00 03 51 00 00
					05 01 00 00 78 00 02 11 00
					05 01 00 00 14 00 02 29 00
				];
				qcom,mdss-dsi-off-command = [05 01 00 00 32 00 02 28 00
					05 01 00 00 20 00 02 10 00
				];
				qcom,mdss-dsi-on-command-state = "dsi_lp_mode";
				qcom,mdss-dsi-off-command-state = "dsi_lp_mode";
				qcom,mdss-dsi-lp1-command = [39 01 00 00 28 00 02 fe 00
					05 01 00 00 00 00 02 39 00
				];
				qcom,mdss-dsi-lp1-command-state = "dsi_lp_mode";
				qcom,mdss-dsi-nolp-command = [39 01 00 00 00 00 02 fe 00
					05 01 00 00 00 00 02 38 00
				];
				qcom,mdss-dsi-nolp-command-state = "dsi_lp_mode";
				zte,mdss-dsi-hbm-on-commands = [39 01 00 00 00 00 02 fe 00
					39 01 00 00 00 00 02 51 0f ff
				];
				zte,mdss-dsi-hbm-off-commands = [39 01 00 00 00 00 02 fe 00
					39 01 00 00 00 00 02 51 03 22
				];
				zte,mdss-dsi-hbm-on-commands-state = "dsi_hs_mode";
				zte,mdss-dsi-hbm-off-commands-state = "dsi_hs_mode";
				qcom,mdss-dsi-panel-phy-timings = [00 22 08 09 19 23 09 09 09 02 04 00 1c 0e];
				qcom,display-topology = <1 0 1>;
				qcom,default-topology-index = <0>;
			};
		};
    };
};
